## GrcAICam/yolo_example/nrf/boards/Grovety/nrf52833_aicam/Kconfig.defconfig
```kconfig
# Copyright (c) 2019 Nordic Semiconductor ASA
# SPDX-License-Identifier: Apache-2.0

if BOARD_NRF52833_AICAM

config BT_CTLR
	default BT

endif # BOARD_NRF52833_AICAM
```

## GrcAICam/yolo_example/nrf/boards/Grovety/nrf52833_aicam/Kconfig.nrf52833_aicam
```kconfig
# Copyright (c) 2019 Nordic Semiconductor ASA
# SPDX-License-Identifier: Apache-2.0

config BOARD_NRF52833_AICAM
	select SOC_NRF52833_QIAA
```
